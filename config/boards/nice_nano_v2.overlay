#include <dt-bindings/led/led.h>

&spi1 {
	compatible = "nordic,nrf-spim";
	/* Cannot be used together with i2c0. */
	status = "okay";
	mosi-pin = <6>;
	// Unused pins, needed for SPI definition, but not used by the sk6812 driver itself.
	sck-pin = <5>;
	miso-pin = <7>;

	led_strip: sk6812@0 {
		compatible = "worldsemi,sk6812-spi";
		label = "SK6812";

		/* SPI */
		reg = <0>; /* ignored, but necessary for SPI bindings */
		spi-max-frequency = <4000000>;

		/* SK6812 */
		chain-length = <35>; /* There are per-key RGB, but the first 6 are underglow */
		spi-one-frame = <0x70>;
		spi-zero-frame = <0x40>;
		color-mapping = <LED_COLOR_ID_GREEN LED_COLOR_ID_RED LED_COLOR_ID_BLUE>;
	};
};

/ {
	chosen {
		zmk,underglow = &led_strip;
	};
};
